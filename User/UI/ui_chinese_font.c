#include "ui_chinese_font.h"

#include "LCD_1in69.h"

#include <stdint.h>

#define UI_CHINESE_GLYPH_WIDTH 16U
#define UI_CHINESE_GLYPH_HEIGHT 16U
#define UI_CHINESE_GLYPH_ROW_BYTES 2U
#define UI_CHINESE_GLYPH_GAP 2U
#define UI_CHINESE_SMALL_GLYPH_WIDTH 8U
#define UI_CHINESE_SMALL_GLYPH_HEIGHT 8U
#define UI_CHINESE_SMALL_GLYPH_GAP 1U

typedef struct {
  uint16_t codepoint;
  UBYTE bitmap[UI_CHINESE_GLYPH_HEIGHT * UI_CHINESE_GLYPH_ROW_BYTES];
} UIChineseGlyph;

/* 16x16 monochrome glyphs generated from SimSun for the UI text below. */
static const UIChineseGlyph ui_chinese_glyphs[] = {
  { 0x661FU, { 0x1FU, 0xF0U, 0x10U, 0x10U, 0x1FU, 0xF0U, 0x10U, 0x10U, 0x1FU, 0xF0U, 0x01U, 0x00U, 0x11U, 0x00U, 0x1FU, 0xF8U, 0x21U, 0x00U, 0x41U, 0x00U, 0x1FU, 0xF0U, 0x01U, 0x00U, 0x01U, 0x00U, 0x7FU, 0xFCU, 0x00U, 0x00U, 0x00U, 0x00U } }, /* Xing */
  { 0x671FU, { 0x22U, 0x7CU, 0x7FU, 0x44U, 0x22U, 0x44U, 0x22U, 0x44U, 0x3EU, 0x7CU, 0x22U, 0x44U, 0x22U, 0x44U, 0x3EU, 0x44U, 0x22U, 0x7CU, 0x22U, 0x44U, 0xFFU, 0x44U, 0x04U, 0x84U, 0x22U, 0x84U, 0x41U, 0x14U, 0x82U, 0x08U, 0x00U, 0x00U } }, /* Qi */
  { 0x65E5U, { 0x1FU, 0xF0U, 0x10U, 0x10U, 0x10U, 0x10U, 0x10U, 0x10U, 0x10U, 0x10U, 0x10U, 0x10U, 0x1FU, 0xF0U, 0x10U, 0x10U, 0x10U, 0x10U, 0x10U, 0x10U, 0x10U, 0x10U, 0x10U, 0x10U, 0x10U, 0x10U, 0x1FU, 0xF0U, 0x10U, 0x10U, 0x00U, 0x00U } }, /* Ri */
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  { 0x63A5U, { 0x10U, 0x40U, 0x13U, 0xFCU, 0x10U, 0x00U, 0xFDU, 0x08U, 0x10U, 0x90U, 0x17U, 0xFEU, 0x10U, 0x40U, 0x18U, 0x40U, 0x37U, 0xFEU, 0xD0U, 0x88U, 0x11U, 0x08U, 0x10U, 0x90U, 0x10U, 0x60U, 0x51U, 0x98U, 0x26U, 0x04U, 0x00U, 0x00U } }  /* Jie */
};

#define UI_CHINESE_GLYPH_COUNT ((UWORD)(sizeof(ui_chinese_glyphs) / sizeof(ui_chinese_glyphs[0])))

static uint32_t UIChinese_NextCodepoint(const char** text)
{
  const UBYTE* bytes = (const UBYTE*)*text;
  uint32_t codepoint;

  if (bytes[0] == 0U)
  {
    return 0UL;
  }

  if ((bytes[0] & 0xF0U) == 0xE0U)
  {
    codepoint = ((uint32_t)(bytes[0] & 0x0FU) << 12) |
                ((uint32_t)(bytes[1] & 0x3FU) << 6) |
                (uint32_t)(bytes[2] & 0x3FU);
    *text += 3;
    return codepoint;
  }

  codepoint = bytes[0];
  *text += 1;
  return codepoint;
}

static const UBYTE* UIChinese_FindGlyph(uint32_t codepoint)
{
  UWORD index;

  for (index = 0U; index < UI_CHINESE_GLYPH_COUNT; index++)
  {
    if ((uint32_t)ui_chinese_glyphs[index].codepoint == codepoint)
    {
      return ui_chinese_glyphs[index].bitmap;
    }
  }

  return 0;
}

UWORD UIChinese_TextWidth(const char* text, UWORD scale)
{
  const char* cursor = text;
  UWORD count = 0U;

  if ((text == 0) || (scale == 0U))
  {
    return 0U;
  }

  while (*cursor != '\0')
  {
    (void)UIChinese_NextCodepoint(&cursor);
    count++;
  }

  return (count == 0U) ? 0U :
         (UWORD)(((count * UI_CHINESE_GLYPH_WIDTH) +
                  ((count - 1U) * UI_CHINESE_GLYPH_GAP)) * scale);
}

void UIChinese_DrawText(UWORD x, UWORD y, const char* text, UWORD color, UWORD scale)
{
  const char* cursor = text;
  UWORD glyph_index = 0U;

  if ((text == 0) || (scale == 0U))
  {
    return;
  }

  while (*cursor != '\0')
  {
    uint32_t codepoint = UIChinese_NextCodepoint(&cursor);
    const UBYTE* bitmap = UIChinese_FindGlyph(codepoint);

    if (bitmap != 0)
    {
      UWORD row;
      UWORD glyph_x = (UWORD)(x + (glyph_index * (UI_CHINESE_GLYPH_WIDTH + UI_CHINESE_GLYPH_GAP) * scale));

      for (row = 0U; row < UI_CHINESE_GLYPH_HEIGHT; row++)
      {
        UWORD col;

        for (col = 0U; col < UI_CHINESE_GLYPH_WIDTH; col++)
        {
          UBYTE row_byte = bitmap[(row * UI_CHINESE_GLYPH_ROW_BYTES) + (col / 8U)];

          if ((row_byte & (UBYTE)(0x80U >> (col % 8U))) != 0U)
          {
            UWORD x0 = (UWORD)(glyph_x + (col * scale));
            UWORD y0 = (UWORD)(y + (row * scale));

            LCD_1IN69_FillRect_FastStatic(x0,
                                          y0,
                                          (UWORD)(x0 + scale - 1U),
                                          (UWORD)(y0 + scale - 1U),
                                          color);
          }
        }
      }
    }

    glyph_index++;
  }
}

void UIChinese_DrawCenteredInRect(UWORD x, UWORD y, UWORD width, const char* text, UWORD color, UWORD scale)
{
  UWORD text_width = UIChinese_TextWidth(text, scale);
  UWORD text_x = (text_width >= width) ? x : (UWORD)(x + ((width - text_width) / 2U));

  UIChinese_DrawText(text_x, y, text, color, scale);
}

UWORD UIChinese_SmallTextWidth(const char* text)
{
  const char* cursor = text;
  UWORD count = 0U;

  if (text == 0)
  {
    return 0U;
  }

  while (*cursor != '\0')
  {
    (void)UIChinese_NextCodepoint(&cursor);
    count++;
  }

  return (count == 0U) ? 0U :
         (UWORD)((count * UI_CHINESE_SMALL_GLYPH_WIDTH) +
                 ((count - 1U) * UI_CHINESE_SMALL_GLYPH_GAP));
}

void UIChinese_DrawTextSmall(UWORD x, UWORD y, const char* text, UWORD color)
{
  const char* cursor = text;
  UWORD glyph_index = 0U;

  if (text == 0)
  {
    return;
  }

  while (*cursor != '\0')
  {
    uint32_t codepoint = UIChinese_NextCodepoint(&cursor);
    const UBYTE* bitmap = UIChinese_FindGlyph(codepoint);

    if (bitmap != 0)
    {
      UWORD row;
      UWORD glyph_x = (UWORD)(x + (glyph_index *
          (UI_CHINESE_SMALL_GLYPH_WIDTH + UI_CHINESE_SMALL_GLYPH_GAP)));

      for (row = 0U; row < UI_CHINESE_SMALL_GLYPH_HEIGHT; row++)
      {
        UWORD col;

        for (col = 0U; col < UI_CHINESE_SMALL_GLYPH_WIDTH; col++)
        {
          UWORD source_row;
          UBYTE pixel_on = 0U;

          for (source_row = (UWORD)(row * 2U);
               source_row < (UWORD)((row * 2U) + 2U);
               source_row++)
          {
            UWORD source_col;

            for (source_col = (UWORD)(col * 2U);
                 source_col < (UWORD)((col * 2U) + 2U);
                 source_col++)
            {
              UBYTE row_byte = bitmap[(source_row * UI_CHINESE_GLYPH_ROW_BYTES) +
                                      (source_col / 8U)];
              if ((row_byte & (UBYTE)(0x80U >> (source_col % 8U))) != 0U)
              {
                pixel_on = 1U;
              }
            }
          }

          if (pixel_on != 0U)
          {
            UWORD pixel_x = (UWORD)(glyph_x + col);
            UWORD pixel_y = (UWORD)(y + row);
            LCD_1IN69_FillRect_FastStatic(pixel_x,
                                          pixel_y,
                                          pixel_x,
                                          pixel_y,
                                          color);
          }
        }
      }
    }

    glyph_index++;
  }
}

void UIChinese_DrawCenteredInRectSmall(UWORD x,
                                       UWORD y,
                                       UWORD width,
                                       const char* text,
                                       UWORD color)
{
  UWORD text_width = UIChinese_SmallTextWidth(text);
  UWORD text_x = (text_width >= width) ? x :
                 (UWORD)(x + ((width - text_width) / 2U));

  UIChinese_DrawTextSmall(text_x, y, text, color);
}
